## conf/layer.conf
```bitbake
# We have a conf and classes directory, add to BBPATH
BBPATH .= ":${LAYERDIR}"

# We have recipes-* directories, add to BBFILES
BBFILES += "${LAYERDIR}/recipes-*/*/*.bb \
            ${LAYERDIR}/recipes-*/*/*.bbappend"

BBFILE_COLLECTIONS += "meta-vuhf-sdr"
BBFILE_PATTERN_meta-vuhf-sdr = "^${LAYERDIR}/"
BBFILE_PRIORITY_meta-vuhf-sdr = "6"

LAYERDEPENDS_meta-vuhf-sdr = "core"
LAYERSERIES_COMPAT_meta-vuhf-sdr = "scarthgap"
```

## conf/machine/custom-zynq-7020.conf
```bitbake
#Base this machine configuration off of the zynq-7000 board and then make changes below
require conf/machine/zynq-generic.conf
HDF_BASE = "file://"
HDF_PATH = "${TOPDIR}/sources/meta-vuhf-sdr/recipes-bsp/hdf/files/system_top.xsa" 

SPL_BINARY ?= "spl/boot.bin"

IMAGE_BOOT_FILES += " \
		boot.bin \
		uEnv.txt \
		boot.scr \
		"
KERNEL_IMAGETYPE = "uImage"
```
